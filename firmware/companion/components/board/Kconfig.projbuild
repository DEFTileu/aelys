## firmware/companion/components/board/Kconfig.projbuild
```kconfig
menu "Aelys board"
    config AELYS_INPUT_SELFTEST
        bool "Input self-test (touch latency, combo, ring fps; logs only)"
        default n
        help
            Runs a synthetic touch/button session once after boot and logs the results.
            Leave off in release builds.
endmenu
```

## firmware/companion/main/Kconfig.projbuild
```kconfig
menu "Aelys companion"
    config AELYS_SPARSE_SCREEN_SWITCH
        bool "Invalidate painted regions for Home/Today navigation (experimental)"
        default n
        help
            Keep normal screen rendering as the fallback until the same-workload
            probe validates the smaller dirty regions on the board.
    config AELYS_TZ
        string "POSIX time zone"
        default "<+05>-5"
        help
            TZ string for local time on the clock (default: UTC+5).

    config AELYS_NO_WIFI
        bool "Do not start Wi-Fi, SNTP and Improv"
        default n
        help
            Keeps the radio off (heap and power measurements, bench work).
    config AELYS_METRICS_PERIOD_S
        int "Metrics log period, seconds"
        range 5 3600
        default 60
        help
            One WARN line with heap, frame, stack and boot figures every period.
    config AELYS_LINK_CHAOS_S
        int "Link chaos: forced reconnect period, seconds (dev only)"
        range 0 3600
        default 0
        help
            0 = off. Otherwise the link closes its socket and signs in again after this many seconds online,
            to measure heap at reconnect. Never set it in a release build.
    config AELYS_IDENTITY_SELFTEST
        bool "Run the identity self-test at boot (bench only)"
        default n
        help
            Checks the device key, SAS and Wi-Fi decryption against generated vectors, in RAM only
            (never writes NVS), and logs "identity selftest PASS" or FAIL.
    config AELYS_PERF_PROBE
        bool "Performance probe (bench only)"
        depends on !FREERTOS_SMP && !FREERTOS_UNICORE && FREERTOS_RUN_TIME_COUNTER_TYPE_U64 && FREERTOS_RUN_TIME_STATS_USING_ESP_TIMER
        select FREERTOS_USE_TRACE_FACILITY
        select FREERTOS_VTASKLIST_INCLUDE_COREID
        default n
        help
            Bench-only task and UI diagnostics. First enable FreeRTOS runtime
            statistics, the ESP timer and the 64-bit runtime counter; Kconfig choice
            members cannot be selected by another symbol. Adds a 4096-byte
            task stack and static snapshot storage. Never use in release builds.
endmenu
```
